## app/src/modules/cloud/Kconfig.cloud
```kconfig
#
# Copyright (c) 2024 Nordic Semiconductor
#
# SPDX-License-Identifier: LicenseRef-Nordic-5-Clause
#

menuconfig CLOUD_MODULE
	bool "Cloud module"
	default y if NRF_CLOUD_COAP

if CLOUD_MODULE

config CLOUD_MODULE_SHELL
	bool "Enable cloud shell"
	default y if SHELL
	help
	  Enable cloud shell commands.

config CLOUD_MODULE_PAYLOAD_BUFFER_MAX_SIZE
	int "Payload maximum buffer size"
	default 128
	help
	  Maximum size of the buffer sent over the payload channel when sending RAW JSON messages
	  to the cloud.

config CLOUD_MODULE_SHADOW_RESPONSE_BUFFER_MAX_SIZE
	int "Payload maximum buffer size"
	default 512
	help
	  Maximum size of the buffer used to receive shadow responses from the cloud.

config CLOUD_MODULE_CONFIRMABLE_MESSAGES
	bool "Use confirmable messages"
	help
	  Use confirmable messages for CoAP communications with nRF Cloud.
	  Confirmable messages are retransmitted COAP_MAX_RETRANSMIT times
	  until an acknowledgment is received.

config CLOUD_MODULE_BACKOFF_INITIAL_SECONDS
	int "Reconnection backoff time in seconds"
	default 60
	help
	  Time in between reconnection attempts to the nRF Cloud CoAP server.
	  The timer starts after the last failed attempt.

choice CLOUD_MODULE_BACKOFF_TYPE
	prompt "Reconnection backoff type"
	default CLOUD_MODULE_BACKOFF_TYPE_LINEAR

config CLOUD_MODULE_BACKOFF_TYPE_EXPONENTIAL
	bool "Exponential backoff"
	help
	  Exponential backoff doubles the reconnection timeout after each failed attempt.
	  The maximum reconnection timeout is defined by CLOUD_MODULE_BACKOFF_MAX_SECONDS.

config CLOUD_MODULE_BACKOFF_TYPE_LINEAR
	bool "Linear backoff"
	help
	  Linear backoff adds a fixed amount of time to the reconnection timeout after each failed attempt,
	  as defined by CLOUD_MODULE_BACKOFF_LINEAR_INCREMENT_SECONDS.

config CLOUD_MODULE_BACKOFF_TYPE_NONE
	bool "No backoff"
	help
	  No backoff means that the reconnection timeout is constant at the value defined by
	  CLOUD_MODULE_BACKOFF_INITIAL_SECONDS.

endchoice

config CLOUD_MODULE_BACKOFF_LINEAR_INCREMENT_SECONDS
	int "Reconnection backoff time increment"
	default 60
	help
	  Time added to the reconnection timeout after each failed attempt in seconds.
	  The maximum reconnection timeout is defined by CLOUD_MODULE_BACKOFF_MAX_SECONDS.

config CLOUD_MODULE_BACKOFF_MAX_SECONDS
	int "Maximum reconnection timeout"
	default 3600
	help
	  Maximum reconnection backoff value in seconds.

config CLOUD_MODULE_THREAD_STACK_SIZE
	int "Thread stack size"
	default 6144

config CLOUD_MODULE_MESSAGE_QUEUE_SIZE
	int "Message queue size"
	default 5
	help
	  ZBus subscriber message queue size.

config CLOUD_MODULE_WATCHDOG_TIMEOUT_SECONDS
	int "Watchdog timeout"
	default 180
	help
	  Timeout in seconds for the cloud module watchdog.
	  The timeout given in this option covers both:
	    * Waiting for an incoming message in zbus_sub_wait_msg().
	    * Time spent processing the message, defined by
	      CONFIG_CLOUD_MODULE_MSG_PROCESSING_TIMEOUT_SECONDS.
	  Ensure that this value exceeds CONFIG_CLOUD_MODULE_MSG_PROCESSING_TIMEOUT_SECONDS.
	  A small difference between the two can mean more frequent watchdog feeds, which increases
	  power consumption.


config CLOUD_MODULE_MSG_PROCESSING_TIMEOUT_SECONDS
	int "Maximum message processing time"
	default 120
	help
	  Maximum time allowed for processing a single message in the module's state machine.
	  The value must be smaller than CONFIG_CLOUD_MODULE_WATCHDOG_TIMEOUT_SECONDS.

module = CLOUD_MODULE
module-str = Cloud
source "subsys/logging/Kconfig.template.log_config"

endif # CLOUD_MODULE
```

## app/src/modules/controller/Kconfig.controller
```kconfig
# SPDX-License-Identifier: Apache-2.0

menuconfig CONTROLLER_MODULE
	bool "Controller Module"
	default y
	depends on ZBUS && SMF
	help
	  Enable the controller module that coordinates all other modules
	  and handles application business logic.

if CONTROLLER_MODULE

module = CONTROLLER_MODULE
module-str = Controller module
source "subsys/logging/Kconfig.template.log_config"

config CONTROLLER_MODULE_STACK_SIZE
	int "Controller module thread stack size"
	default 2048
	help
	  Stack size for the controller module thread.

config CONTROLLER_MODULE_THREAD_PRIORITY
	int "Controller module thread priority"
	default 4
	help
	  Priority for the controller module thread.

config CONTROLLER_MODULE_SAMPLE_INTERVAL_MS
	int "Default sensor sampling interval (ms)"
	default 5000
	help
	  Default interval between sensor data requests.

config CONTROLLER_MODULE_THREAD_SLEEP_MS
	int "Controller module thread sleep interval (ms)"
	default 100
	help
	  Sleep interval for the controller module thread main loop.

config CONTROLLER_MODULE_MAX_RETRIES
	int "Maximum error retries"
	default 3
	help
	  Maximum number of consecutive errors before entering error state.

config CONTROLLER_MODULE_RECOVERY_DELAY_MS
	int "Recovery attempt delay (ms)"
	default 2000
	help
	  Delay before attempting recovery from error state.

config CONTROLLER_MODULE_AUTO_START_SAMPLING
	bool "Auto-start sensor sampling"
	default y
	help
	  Automatically start sensor data sampling when controller enters idle state.

endif # CONTROLLER_MODULE
```

## app/src/modules/network/Kconfig.network
```kconfig
#
# Copyright (c) 2024 Nordic Semiconductor
#
# SPDX-License-Identifier: LicenseRef-Nordic-5-Clause
#

menuconfig NETWORK_MODULE
	bool "Network Module"
	default y
	depends on ZBUS && (NRF_MODEM_LIB_NET_IF || (WIFI_NRF700X && WIFI_MGMT_EXT) || BOARD_NATIVE_POSIX)
	help
	  Enable the network module for connectivity management with
	  ZBUS communication support. Provides state machine-based
	  network connection handling and shell commands.

if NETWORK_MODULE

module = NETWORK_MODULE
module-str = Network module
source "subsys/logging/Kconfig.template.log_config"

config NETWORK_MODULE_SHELL
	bool "Network module shell commands"
	default y if SHELL
	help
	  Enable shell commands for the network module.

config NETWORK_MODULE_STACK_SIZE
	int "Network module thread stack size"
	default 2048

config NETWORK_MODULE_WATCHDOG_TIMEOUT_SECONDS
	int "Watchdog timeout"
	default 600
	help
	  Timeout in seconds for the network module watchdog.
	  The timeout given in this option covers both:
	    * Waiting for an incoming message in zbus_sub_wait_msg().
	    * Time spent processing the message, defined by
	      CONFIG_NETWORK_MODULE_MSG_PROCESSING_TIMEOUT_SECONDS.
	  Ensure that this value exceeds CONFIG_NETWORK_MODULE_MSG_PROCESSING_TIMEOUT_SECONDS.
	  A small difference between the two can mean more frequent watchdog feeds, which increases
	  power consumption.

config NETWORK_MODULE_MSG_PROCESSING_TIMEOUT_SECONDS
	int "Maximum message processing time"
	default 570
	help
	  Maximum time allowed for processing a single message in the module's state machine.
	  The value must be smaller than CONFIG_NETWORK_MODULE_WATCHDOG_TIMEOUT_SECONDS.

config NETWORK_MODULE_SEARCH_NETWORK_ON_STARTUP
	bool "Search for network on startup"
	default y
	help
	  If enabled, the module will search for a network on startup.
	  If disabled, network search must be triggered by a NETWORK_CONNECT_REQUEST message.

endif # NETWORK_MODULE
```

## app/src/modules/sensor/Kconfig.sensor
```kconfig
# SPDX-License-Identifier: Apache-2.0

config SENSOR_MODULE
	bool "Sensor Module"
	default y
	depends on ZBUS && SENSOR
	help
	  Enable the sensor module for multi-sensor data collection
	  with ZBUS communication support.

if SENSOR_MODULE

config SENSOR_MODULE_STACK_SIZE
	int "Sensor thread stack size"
	default 2048
	help
	  Stack size for the sensor thread.

config SENSOR_MODULE_THREAD_PRIORITY
	int "Sensor thread priority"
	default 5
	help
	  Priority for the sensor thread.

config SENSOR_MODULE_LOG_LEVEL
	int "Sensor module log level"
	default 3
	help
	  Log level for the sensor module (0-4, where 0 is none and 4 is debug).

config SENSOR_MODULE_READ_TIMEOUT_MS
	int "Sensor read timeout (ms)"
	default 5000
	help
	  Timeout for automatic sensor reading when no requests are received.

config SENSOR_MODULE_RECOVERY_DELAY_MS
	int "Recovery attempt delay (ms)"
	default 2000
	help
	  Delay between sensor recovery attempts.

config SENSOR_MODULE_MAX_RETRIES
	int "Maximum recovery attempts"
	default 3
	help
	  Maximum number of recovery attempts before giving up.

# Sensor-specific warmup configurations
config SENSOR_MODULE_WARMUP_ENABLE
	bool "Enable sensor warmup periods"
	default y
	help
	  Enable warmup delays for sensors that need stabilization time
	  before providing accurate readings.

config SENSOR_MODULE_CCS811_WARMUP_MS
	int "CCS811 warmup period (ms)"
	default 5000
	depends on SENSOR_MODULE_WARMUP_ENABLE
	help
	  Warmup time required for CCS811 sensor before first valid reading.
	  CCS811 needs time to stabilize after power-on or reset.

config SENSOR_MODULE_BME280_WARMUP_MS
	int "BME280 warmup period (ms)"
	default 100
	depends on SENSOR_MODULE_WARMUP_ENABLE
	help
	  Warmup time required for BME280 sensor before first valid reading.

config SENSOR_MODULE_HM3301_WARMUP_MS
	int "HM3301 warmup period (ms)"
	default 100
	depends on SENSOR_MODULE_WARMUP_ENABLE
	help
	  Warmup time required for HM3301 sensor before first valid reading.

config CCS811_ENV_COMPENSATION
	bool "Enable environmental compensation for CCS811"
	default y
	depends on CCS811 && BME280
	help
	  Enable updating CCS811 environmental data register with 
	  temperature and humidity values from BME280 sensor.
	  This improves accuracy of CO2 and VOC measurements by
	  compensating for environmental conditions.

config CCS811_DEFAULT_TEMPERATURE
	int "Fallback temperature for CCS811, Celsius"
	default 22
	depends on CCS811_ENV_COMPENSATION
	help
	  Default temperature value to use for CCS811 environmental
	  compensation when BME280 sensor is not available or fails.

config CCS811_DEFAULT_HUMIDITY
	int "Fallback humidity for CCS811, %RH"
	default 50
	depends on CCS811_ENV_COMPENSATION
	help
	  Default humidity value to use for CCS811 environmental
	  compensation when BME280 sensor is not available or fails.

config CCS811_TEMP_THRESHOLD_MICRO
	int "CCS811 temperature update threshold (micro-degrees)"
	default 500000
	depends on CCS811_ENV_COMPENSATION
	help
	  Temperature change threshold in micro-degrees Celsius for updating
	  CCS811 environmental compensation. Default is 0.5°C.

config CCS811_HUM_THRESHOLD_MICRO
	int "CCS811 humidity update threshold (micro-percent)"
	default 500000
	depends on CCS811_ENV_COMPENSATION
	help
	  Humidity change threshold in micro-percent RH for updating
	  CCS811 environmental compensation. Default is 0.5%RH.

config SENSOR_MODULE_ZBUS_SUBSCRIBER_QUEUE_SIZE
	int "ZBUS subscriber queue size"
	default 4
	help
	  Queue size for the ZBUS sensor request subscriber.

config SENSOR_MODULE_THREAD_SLEEP_MS
	int "Thread sleep interval (ms)"
	default 100
	help
	  Sleep interval for the sensor thread main loop.

config SENSOR_MODULE_PUBLISH_TIMEOUT_MS
	int "ZBUS publish timeout (ms)"
	default 100
	help
	  Timeout for publishing sensor request messages.

config SENSOR_MODULE_DATA_PUBLISH_TIMEOUT_MS
	int "ZBUS data publish timeout (ms)"
	default 1000
	help
	  Timeout for publishing sensor response data messages.

config SENSOR_MODULE_MAX_RECOVERY_ATTEMPTS
	int "Maximum recovery attempts before exhaustion"
	default 5
	help
	  Maximum number of consecutive recovery attempts before
	  giving up and staying in error state.

config SENSOR_MODULE_RECOVERY_RETRY_DELAY_MS
	int "Delay between recovery retry attempts (ms)"
	default 1000
	help
	  Delay between recovery retry attempts when recovery fails.

config SENSOR_MODULE_HEALTH_SAMPLE_SIZE
	int "Health monitoring sample size"
	default 10
	help
	  Number of recent attempts to consider for sensor health calculation.

config SENSOR_MODULE_HEALTH_FAILURE_THRESHOLD_PERCENT
	int "Health failure threshold percentage"
	default 50
	range 1 99
	help
	  Failure rate percentage above which a sensor is considered unhealthy.

endif # SENSOR_MODULE
```

## drivers/sensor/Kconfig
```kconfig
# SPDX-License-Identifier: Apache-2.0

menu "Sensor Drivers"

rsource "sen0466/Kconfig"

endmenu
```

## drivers/sensor/sen0466/Kconfig
```kconfig
# Copyright (c) 2024-2025 Natalia Pluta
# SPDX-License-Identifier: Apache-2.0

menuconfig SEN0466
	bool "DFRobot SEN0466 CO sensor"
	default y
	depends on DT_HAS_DFROBOT_SEN0466_ENABLED
	select I2C
	help
	  Enable driver for DFRobot SEN0466 electrochemical CO sensor.
	  This sensor provides CO concentration measurements from 0-1000 ppm
	  via I2C interface.
```

## dts/bindings/sensor/dfrobot,sen0466.yaml
```yaml
# Copyright (c) 2025 Natalia Pluta
# SPDX-License-Identifier: Apache-2.0

description: DFRobot SEN0466 electrochemical CO sensor

compatible: "dfrobot,sen0466"

include: [sensor-device.yaml, i2c-device.yaml]
```
